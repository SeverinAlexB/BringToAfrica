## conf/local.conf
```bitbake
db.default.user=africa
db.default.password="africa"
ebean.default="models.*"
jpa.default=defaultPersistenceUnit
db.default.driver=org.postgresql.Driver
db.default.url="jdbc:postgresql://localhost:5432/bringtoafrica"
```
